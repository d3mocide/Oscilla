## firmware-c5/main/Kconfig.projbuild
```kconfig
menu "Oscilla probe"

choice OSCILLA_OCP_TRANSPORT
    prompt "OCP control transport"
    default OSCILLA_OCP_TRANSPORT_UART
    help
        Where the probe listens for OCP commands.

config OSCILLA_OCP_TRANSPORT_UART
    bool "Grove UART0 (GPIO11 TX / GPIO12 RX)"
    help
        The real link (Rev D §3). Shares its pins with the ROM console, so
        boot text appears on the wire; the protocol tolerates that.

config OSCILLA_OCP_TRANSPORT_USB
    bool "USB Serial/JTAG (bench)"
    help
        For driving the probe from a host over its USB port with no Grove
        cable attached. Console logs share the stream.

endchoice

config OSCILLA_STATUS_LED
    bool "Status LED heartbeat"
    default y
    help
        Drive the XIAO user LED (GPIO27) as a liveness indicator. Disable
        to save the last few microamps in the field.

config OSCILLA_STATUS_LED_PERIOD_MS
    int "Heartbeat period (ms)"
    depends on OSCILLA_STATUS_LED
    range 500 10000
    default 2000

config OSCILLA_CC1101_BENCH
    bool "CC1101 bench console on USB (D-15 requalification)"
    depends on OSCILLA_OCP_TRANSPORT_UART
    default n
    help
        Bench-only: run the CC1101 bring-up at boot and serve the
        bench-cc1101-driver line console (i, d, up, reset, cycle N, rxcyc N,
        gap N, quiet, loud, lload on|off) on USB Serial/JTAG. OCP stays on
        the Grove UART. Receive-only; adds no OCP verb.

config OSCILLA_SYNTH_BENCH
    bool "Synthetic network/BLE events from a USB console (bench)"
    depends on OSCILLA_OCP_TRANSPORT_UART && !OSCILLA_CC1101_BENCH
    default n
    help
        Bench-only: a USB Serial/JTAG console (`synth <wifi_n> <ble_n>
        <seconds> [keep]`) injects made-up `network` and `ble` events into the
        normal event queue, so the deck's table caps and wardrive log can be
        driven past their limits without anything on the air. Transmits
        nothing; adds no OCP verb. Never set in the default build.

config OSCILLA_ZIG_ACK_TEST_IDENTITY
    bool "Fixed 802.15.4 identity for ACK bench test"
    default n
    help
        Bench-only: make a known unicast eligible for automatic ACK before
        zig_radio enables promiscuous receive, which disables automatic ACK.

config OSCILLA_ZIG_ACK_TEST_PANID
    hex "ACK test PAN ID"
    depends on OSCILLA_ZIG_ACK_TEST_IDENTITY
    default 0x1A2B

config OSCILLA_ZIG_ACK_TEST_SHORT_ADDR
    hex "ACK test short address"
    depends on OSCILLA_ZIG_ACK_TEST_IDENTITY
    default 0x0001

endmenu
```
